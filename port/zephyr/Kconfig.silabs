## port/zephyr/Kconfig.silabs
```kconfig
# Copyright (c) 2026 Hubble Network, Inc.
# SPDX-License-Identifier: Apache-2.0

if HUBBLE_SAT_NETWORK

configdefault SOC_GECKO_CUSTOM_RADIO_PHY
      	default y

if HUBBLE_BLE_NETWORK

configdefault SILABS_SISDK_RAIL_MULTIPROTOCOL
      	default y

endif # HUBBLE_BLE_NETWORK

endif # HUBBLE_SAT_NETWORK
```

## samples/zephyr/sat-continuous/Kconfig
```kconfig
# Copyright (c) 2026 Hubble Network, Inc.
# SPDX-License-Identifier: Apache-2.0

menu "Hubble Network Satellite Sample options"

config SAMPLE_PROVIDE_SAT_BOARD_SUPPORT
    bool "Provide satellite board suport for test purpose"
    default y
    help
	Targets that support satellite must select it, otherwise
	board APIs will be mocked in the sample.

endmenu

source "Kconfig.zephyr"

module = APP
module-str = APP
source "subsys/logging/Kconfig.template.log_config"
```
